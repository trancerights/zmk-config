## config/west.yml
```yaml
manifest:
  remotes:
    - name: zmkfirmware
      url-base: https://github.com/zmkfirmware
  
  projects:
    - name: zmk
      remote: zmkfirmware
      revision: main
      import: app/west.yml
    - name: zmk-nice-view
      url: https://github.com/nicekeyboards/zmk-nice-view
      revision: main
      path: modules/zmk-nice-view
  
  self:
    path: config
```
